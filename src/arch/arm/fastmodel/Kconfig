## src/arch/arm/fastmodel/Kconfig
```kconfig
# Copyright 2022 Google LLC
#
# Redistribution and use in source and binary forms, with or without
# modification, are permitted provided that the following conditions are
# met: redistributions of source code must retain the above copyright
# notice, this list of conditions and the following disclaimer;
# redistributions in binary form must reproduce the above copyright
# notice, this list of conditions and the following disclaimer in the
# documentation and/or other materials provided with the distribution;
# neither the name of the copyright holders nor the names of its
# contributors may be used to endorse or promote products derived from
# this software without specific prior written permission.
#
# THIS SOFTWARE IS PROVIDED BY THE COPYRIGHT HOLDERS AND CONTRIBUTORS
# "AS IS" AND ANY EXPRESS OR IMPLIED WARRANTIES, INCLUDING, BUT NOT
# LIMITED TO, THE IMPLIED WARRANTIES OF MERCHANTABILITY AND FITNESS FOR
# A PARTICULAR PURPOSE ARE DISCLAIMED. IN NO EVENT SHALL THE COPYRIGHT
# OWNER OR CONTRIBUTORS BE LIABLE FOR ANY DIRECT, INDIRECT, INCIDENTAL,
# SPECIAL, EXEMPLARY, OR CONSEQUENTIAL DAMAGES (INCLUDING, BUT NOT
# LIMITED TO, PROCUREMENT OF SUBSTITUTE GOODS OR SERVICES; LOSS OF USE,
# DATA, OR PROFITS; OR BUSINESS INTERRUPTION) HOWEVER CAUSED AND ON ANY
# THEORY OF LIABILITY, WHETHER IN CONTRACT, STRICT LIABILITY, OR TORT
# (INCLUDING NEGLIGENCE OR OTHERWISE) ARISING IN ANY WAY OUT OF THE USE
# OF THIS SOFTWARE, EVEN IF ADVISED OF THE POSSIBILITY OF SUCH DAMAGE.

menu "Fast Model"

    config USE_ARM_FASTMODEL
        bool "Fast Model integration"
        default n
        depends on USE_ARM_ISA
        depends on USE_SYSTEMC

    if USE_ARM_FASTMODEL
        config PVLIB_HOME
            string "Fast Model portfolio directory"
            default "$(PVLIB_HOME)"

        config PVLIB_FLAVOR
            string "What build flavor of the Fast Model pvlib to use"
            default "Linux64_GCC-7.3"

        config MAXCORE_HOME
            string "Fast Model tools directory"
            default "$(MAXCORE_HOME)"

        config ARMLMD_LICENSE_FILE
            string "ARM license file location"
            default "$(ARMLMD_LICENSE_FILE)"

        config ARMLMD_LICENSE_COUNT
            int "The maximum number of ARM licenses to use concurrently"
            default 1

        config SIMGEN
            string "simgen executable (leave unset for MAXCORE_HOME/bin/simgen"
            default ""
    endif

endmenu
```

## src/mem/ruby/Kconfig
```kconfig
# Copyright 2022 Google LLC
#
# Redistribution and use in source and binary forms, with or without
# modification, are permitted provided that the following conditions are
# met: redistributions of source code must retain the above copyright
# notice, this list of conditions and the following disclaimer;
# redistributions in binary form must reproduce the above copyright
# notice, this list of conditions and the following disclaimer in the
# documentation and/or other materials provided with the distribution;
# neither the name of the copyright holders nor the names of its
# contributors may be used to endorse or promote products derived from
# this software without specific prior written permission.
#
# THIS SOFTWARE IS PROVIDED BY THE COPYRIGHT HOLDERS AND CONTRIBUTORS
# "AS IS" AND ANY EXPRESS OR IMPLIED WARRANTIES, INCLUDING, BUT NOT
# LIMITED TO, THE IMPLIED WARRANTIES OF MERCHANTABILITY AND FITNESS FOR
# A PARTICULAR PURPOSE ARE DISCLAIMED. IN NO EVENT SHALL THE COPYRIGHT
# OWNER OR CONTRIBUTORS BE LIABLE FOR ANY DIRECT, INDIRECT, INCIDENTAL,
# SPECIAL, EXEMPLARY, OR CONSEQUENTIAL DAMAGES (INCLUDING, BUT NOT
# LIMITED TO, PROCUREMENT OF SUBSTITUTE GOODS OR SERVICES; LOSS OF USE,
# DATA, OR PROFITS; OR BUSINESS INTERRUPTION) HOWEVER CAUSED AND ON ANY
# THEORY OF LIABILITY, WHETHER IN CONTRACT, STRICT LIABILITY, OR TORT
# (INCLUDING NEGLIGENCE OR OTHERWISE) ARISING IN ANY WAY OUT OF THE USE
# OF THIS SOFTWARE, EVEN IF ADVISED OF THE POSSIBILITY OF SUCH DAMAGE.

menu "Ruby"
    menuconfig RUBY
        bool "Enable"

    if RUBY
        menu "Ruby protocols"

        config USE_MULTIPLE_PROTOCOLS
            bool 'Use multiple protocols'
            default y

        config PROTOCOL
            string "The 'main' protocol"
            default "MULTIPLE" if USE_MULTIPLE_PROTOCOLS
            help
                This shows up as `buildEnv["PROTOCOL"]`` for backwards
                compatibility, mostly in the Ruby.py config scripts.
                Otherwise, this is ignored.
                If this is set to anything when build with MULTIPLE,
                it will be ignored unless using Ruby.py, in which case
                the protocol specified here will appear as the only protocol.
                Note: This is case sensitive.

        rsource "protocol/Kconfig"
        rsource "../../learning_gem5/part3/Kconfig"

        endmenu

        config SLICC_HTML
            bool 'Create HTML files'

        config NUMBER_BITS_PER_SET
            int 'Max elements in set'
            default 64
    endif


endmenu
```

## src/mem/ruby/protocol/Kconfig
```kconfig
# Copyright 2022 Google LLC
#
# Redistribution and use in source and binary forms, with or without
# modification, are permitted provided that the following conditions are
# met: redistributions of source code must retain the above copyright
# notice, this list of conditions and the following disclaimer;
# redistributions in binary form must reproduce the above copyright
# notice, this list of conditions and the following disclaimer in the
# documentation and/or other materials provided with the distribution;
# neither the name of the copyright holders nor the names of its
# contributors may be used to endorse or promote products derived from
# this software without specific prior written permission.
#
# THIS SOFTWARE IS PROVIDED BY THE COPYRIGHT HOLDERS AND CONTRIBUTORS
# "AS IS" AND ANY EXPRESS OR IMPLIED WARRANTIES, INCLUDING, BUT NOT
# LIMITED TO, THE IMPLIED WARRANTIES OF MERCHANTABILITY AND FITNESS FOR
# A PARTICULAR PURPOSE ARE DISCLAIMED. IN NO EVENT SHALL THE COPYRIGHT
# OWNER OR CONTRIBUTORS BE LIABLE FOR ANY DIRECT, INDIRECT, INCIDENTAL,
# SPECIAL, EXEMPLARY, OR CONSEQUENTIAL DAMAGES (INCLUDING, BUT NOT
# LIMITED TO, PROCUREMENT OF SUBSTITUTE GOODS OR SERVICES; LOSS OF USE,
# DATA, OR PROFITS; OR BUSINESS INTERRUPTION) HOWEVER CAUSED AND ON ANY
# THEORY OF LIABILITY, WHETHER IN CONTRACT, STRICT LIABILITY, OR TORT
# (INCLUDING NEGLIGENCE OR OTHERWISE) ARISING IN ANY WAY OUT OF THE USE
# OF THIS SOFTWARE, EVEN IF ADVISED OF THE POSSIBILITY OF SUCH DAMAGE.


config RUBY_PROTOCOL_GPU_VIPER
    bool "GPU VIPER"
    depends on BUILD_GPU
    default n
config RUBY_PROTOCOL_MOESI_AMD_Base
    bool "MOESI AMD base"
    default n
config RUBY_PROTOCOL_MESI_Two_Level
    bool "MESI two level"
    default n
config RUBY_PROTOCOL_MESI_Three_Level
    bool "MESI three level"
    default n
config RUBY_PROTOCOL_MESI_Three_Level_HTM
    bool "MESI three level HTM"
    default n
config RUBY_PROTOCOL_MI_example
    bool "MI example"
    default n
config RUBY_PROTOCOL_MOESI_CMP_directory
    bool "MOESI CMP directory"
    default n
config RUBY_PROTOCOL_MOESI_CMP_token
    bool "MOESI CMP token"
    default n
config RUBY_PROTOCOL_MOESI_hammer
    bool "MOESI hammer"
    default n
config RUBY_PROTOCOL_Garnet_standalone
    bool "Garnet standalone"
    default n

rsource "chi/Kconfig"
```
